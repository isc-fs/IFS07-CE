VERSION ""

NS_ :

BS_:

BU_: STM32

BO_ 311 VoltagePacket1: 8 STM32
	SG_ Cell1_Voltage : 0|16@0+ (1,0) [0|5000] "mV"  STM32
	SG_ Cell2_Voltage : 16|16@0+ (1,0) [0|5000] "mV"  STM32
	SG_ Cell3_Voltage : 32|16@0+ (1,0) [0|5000] "mV"  STM32
	SG_ Cell4_Voltage : 48|16@0+ (1,0) [0|5000] "mV"  STM32

CM_ BO_ 311 "Voltage 1-4";
BA_DEF_ SG_  "SPN" INT 0 524287;
BA_DEF_ BO_  "VFrameFormat" ENUM  "StandardCAN","ExtendedCAN","reserved","J1939PG";
BA_DEF_  "DatabaseVersion" STRING ;
BA_DEF_  "BusType" STRING ;
BA_DEF_  "ProtocolType" STRING ;
BA_DEF_  "DatabaseCompiler" STRING ;
BA_DEF_DEF_  "SPN" 0;
BA_DEF_DEF_  "VFrameFormat" "J1939PG";
BA_DEF_DEF_  "DatabaseVersion" "DEMO PLUS";
BA_DEF_DEF_  "BusType" "";
BA_DEF_DEF_  "ProtocolType" "";
BA_DEF_DEF_  "DatabaseCompiler" "";
BA_ "ProtocolType" "J1939";
BA_ "BusType" "CAN";
BA_ "DatabaseCompiler" "CSS ELECTRONICS (WWW.CSSELECTRONICS.COM)";
BA_ "DatabaseVersion" "1.0.0";
BA_ "SPN" SG_ 2364540158 EngineSpeed 190;
